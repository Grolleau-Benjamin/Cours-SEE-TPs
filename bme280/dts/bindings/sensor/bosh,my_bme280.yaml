## bme280/dts/bindings/sensor/bosh,my_bme280.yaml
```yaml
description: Capteur de temperature simule pour un TP

// TODO: complete compatible and include

properties:
  // TODO: add 2 properties: initial-millicelsius and maximum-millicelsius
```
